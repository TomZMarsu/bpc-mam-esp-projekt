## main/Kconfig.projbuild
```kconfig
menu "Example Configuration"

    orsource "$IDF_PATH/examples/common_components/env_caps/$IDF_TARGET/Kconfig.env_caps"

    choice BLINK_LED
        prompt "Blink LED type"
        default BLINK_LED_GPIO if IDF_TARGET_ESP32 || IDF_TARGET_ESP32C2
        default BLINK_LED_RMT
        help
            Defines the default peripheral for blink example

        config BLINK_LED_GPIO
            bool "GPIO"
        config BLINK_LED_RMT
            bool "RMT - Addressable LED"
    endchoice

    config BLINK_GPIO
        int "Blink GPIO number"
        range ENV_GPIO_RANGE_MIN ENV_GPIO_OUT_RANGE_MAX
        default 8 if IDF_TARGET_ESP32C3 || IDF_TARGET_ESP32H2 || IDF_TARGET_ESP32C2
        default 18 if IDF_TARGET_ESP32S2
        default 48 if IDF_TARGET_ESP32S3
        default 5
        help
            GPIO number (IOxx) to blink on and off or the RMT signal for the addressable LED.
            Some GPIOs are used for other purposes (flash connections, etc.) and cannot be used to blink.

    config BLINK_PERIOD
        int "Blink period in ms"
        range 10 3600000
        default 1000
        help
            Define the blinking period in milliseconds.

    config BLINK_PERIOD2
        int "Blink period2 in ms"
        range 10 3600000
        default 1000
        help
            Define the blinking period in milliseconds.
    
    config ESP_WIFI_PW_ID
        string "PASSWORD IDENTIFIER"
        depends on  ESP_STATION_EXAMPLE_WPA3_SAE_PWE_HASH_TO_ELEMENT|| ESP_STATION_EXAMPLE_WPA3_SAE_PWE_BOTH
        default ""
        help
            password identifier for SAE H2E

    config ESP_WIFI_SSID
        string "WiFi SSID"
        default "b33"
        help
            SSID (network name) for the example to connect to.

    config ESP_WIFI_PASSWORD
        string "WiFi Password"
        default "257845367"
        help
            WiFi password (WPA or WPA2) for the example to use.

    config ESP_MAXIMUM_RETRY
        int "Maximum retry"
        default 5
        help
            Set the Maximum retry to avoid station reconnecting to the AP unlimited when the AP is really inexistent.

    choice ESP_WIFI_SAE_MODE
        prompt "WPA3 SAE mode selection"
        default ESP_STATION_EXAMPLE_WPA3_SAE_PWE_BOTH
        help
            Select mode for SAE as Hunt and Peck, H2E or both.
        config ESP_STATION_EXAMPLE_WPA3_SAE_PWE_HUNT_AND_PECK
            bool "HUNT AND PECK"
        config ESP_STATION_EXAMPLE_WPA3_SAE_PWE_HASH_TO_ELEMENT
            bool "H2E"
            depends on ESP_WIFI_ENABLE_SAE_H2E
        config ESP_STATION_EXAMPLE_WPA3_SAE_PWE_BOTH
            bool "BOTH"
            depends on ESP_WIFI_ENABLE_SAE_H2E
    endchoice

    choice ESP_WIFI_SCAN_AUTH_MODE_THRESHOLD
        prompt "WiFi Scan auth mode threshold"
        default ESP_WIFI_AUTH_WPA2_PSK
        help
            The weakest authmode to accept in the scan mode.
            This value defaults to ESP_WIFI_AUTH_WPA2_PSK in case password is present and ESP_WIFI_AUTH_OPEN is used.
            Please select ESP_WIFI_AUTH_WEP/ESP_WIFI_AUTH_WPA_PSK in case AP is operating in WEP/WPA mode.

        config ESP_WIFI_AUTH_OPEN
            bool "OPEN"
        config ESP_WIFI_AUTH_WEP
            bool "WEP"
        config ESP_WIFI_AUTH_WPA_PSK
            bool "WPA PSK"
        config ESP_WIFI_AUTH_WPA2_PSK
            bool "WPA2 PSK"
        config ESP_WIFI_AUTH_WPA_WPA2_PSK
            bool "WPA/WPA2 PSK"
        config ESP_WIFI_AUTH_WPA3_PSK
            bool "WPA3 PSK"
        config ESP_WIFI_AUTH_WPA2_WPA3_PSK
            bool "WPA2/WPA3 PSK"
        config ESP_WIFI_AUTH_WAPI_PSK
            bool "WAPI PSK"
    endchoice

    # Uloha 3: NTP setup
    choice SNTP_TIME_SYNC_METHOD
        prompt "Time synchronization method"
        default SNTP_TIME_SYNC_METHOD_IMMED
        help
            Time synchronization method.

        config SNTP_TIME_SYNC_METHOD_IMMED
            bool "update time immediately when received"
        config SNTP_TIME_SYNC_METHOD_SMOOTH
            bool "update time with smooth method (adjtime)"
        config SNTP_TIME_SYNC_METHOD_CUSTOM
            bool "custom implementation"
    endchoice

    # Uloha 7: MAC adresa
        choice BASE_MAC_ADDRESS_STORAGE
        prompt "Storage location of the base MAC address"
        default BASE_MAC_STORED_EFUSE_BLK0
        help
            Select the storage location of the base MAC addresses.
            1. eFuse BLK0: The "Default (Espressif factory)" selection. The
            default base MAC address is written to words 1 and 2 of eFuse block
            0 when the chip was manufactured. Call esp_efuse_mac_get_default()
            read retrieve the "eFuse BLK0" MAC address.
            2. eFuse BLK3: A custom base MAC address is burned by the user into
            eFuse word 0 of block 3. Call esp_efuse_mac_get_custom() to read
            the "eFuse BLK3" MAC address.
            3. Other External Storage: Selecting this option will cause the
            example to call external_storage_mac_get() which is defined in this
            example to simply return a MAC address preset in software. Users
            should modify this function to access their desired storage mediums
            (e.g. flash, EEPROM etc).

        config BASE_MAC_STORED_EFUSE_BLK0
            bool "Default (Espressif factory) eFuse BLK0"
        config BASE_MAC_STORED_EFUSE_BLK3
            bool "Custom eFuse BLK3"
        config BASE_MAC_STORED_OTHER_EXTERNAL_STORAGE
            bool "Other external storage"
    endchoice

    # Uloha 10: Sinus

    choice EXAMPLE_DAC_CONTINUOUS_MODE
        prompt "Select DAC continuous example mode"
        default EXAMPLE_DAC_CONTINUOUS_BY_DMA
        help
            DAC output continuous data by DMA or timer

        config EXAMPLE_DAC_CONTINUOUS_BY_DMA
            bool "By DMA"
        config EXAMPLE_DAC_CONTINUOUS_BY_TIMER
            bool "By Timer"
    endchoice

    config EXAMPLE_WAVE_PERIOD_SEC
        int "Period of switching the waveform (Unit: Sec)"
        default 2
        help
            The waveforms will switch every several seconds,
            this configuration is to specify the switching period

endmenu
```
